## CMakeLists.txt
```
# 1. Specify the minimum CMake version required by Zephyr
cmake_minimum_required(VERSION 3.20.0)

# 2. Find and pull in the core Zephyr RTOS build system configs
find_package(Zephyr REQUIRED HINTS $ENV{ZEPHYR_BASE})

# 3. Define your project name (can be anything you choose)
project(my_esp32c3_project)

# 4. Link your source code files to the 'app' target
target_sources(app PRIVATE src/main.c)
```

## west.yml
```
manifest:
  remotes:
    - name: zephyrproject-rtos
      url-base: https://github.com/zephyrproject-rtos

  projects:
    - name: zephyr
      remote: zephyrproject-rtos
      revision: main # Or specify a stable tag like v3.7.0
      import:
        # 1. This tells West to block all downstream modules from Zephyr by default
        name-blocklist:
          - "*"
        # 2. This explicitly allows ONLY the Espressif HAL module to be downloaded
        name-allowlist:
          - hal_espressif
          - lvgl

  self:
    path: my_esp32_app
```

## prj.conf
```kconfig
# Enable basic serial console support
CONFIG_CONSOLE=y
CONFIG_UART_CONSOLE=y

# Enable GPIO for your upcoming project needs
CONFIG_GPIO=y
```

## src/main.c
```c
#include <zephyr/kernel.h>
#include <zephyr/sys/printk.h>

int main(void)
{
    /* Print a single startup string to the UART console */
    printk("Hello from ESP32-C3 running on Zephyr RTOS!\n");

    int counter = 0;

    while (1) {
        printk("Running loop iteration: %d\n", counter++);
        k_msleep(1000); // Sleep for 1 second (1000 milliseconds)
    }

    return 0;
}
```
